## ESP32/AudioHandler/Kconfig
```kconfig
menu "XasCode Audio"
	menu "Audio Source"
		config XASAUDIO_TX_SAMPLERATE
			int "TX Samplerate"
			default 48000
			help
				Samplerate of the I2S bus. The default of 48kHz works best for most cases
		
		config XASAUDIO_TX_FRAMELENGTH
			int "TX Frame length"
			default 20
			help
				Frame length used per DMA buffer, in milliseconds.
				20ms is a good default together with OPUS decoding.
		config XASAUDIO_TX_DMA_COUNT
			int "TX DMA buffer count"
			default 2
			help
				Number of TX DMA buffers for frames.
				2 provides smooth playback without too much latency.
		config XASAUDIO_TX_STREAM_MAX_BITRATE
			int "Maximum stream playback bitrate"
			default 24000
			help
				Maximum supported bitrate for stream playback. 
				Used to determine the buffer size for the TX Stream.
		config XASAUDIO_TX_STREAM_BUFFER_LENGTH
			int "TX Stream buffer length, in ms"
			default 1000
	endmenu
	
	menu "Audio Sink"
		config XASAUDIO_RX_SAMPLERATE
			int "RX Samplerate"
			default 16000
			help
				Samplerate of the receiving I2S master bus.
				The default of 16kHz is fine for most I2S Microphones, without overwhelming the CPU if performing Opus encoding.
		
		config XASAUDIO_RX_FRAMELENGTH
			int "RX Frame length"
			default 20
			help
				Frame length used per DMA buffer, in milliseconds.
				20ms is a good default together with OPUS decoding.	
	endmenu
endmenu
```

## ESP32/Kconfig.projbuild
```kconfig
menu Xasin

config XASIN_BLE_ENABLE
	bool "Enable Xasin's BLE"
	depends on BTDM_CONTROLLER_MODE_BLE_ONLY || BTDM_CONTROLLER_MODE_BTDM
	default false
	
config XASIN_BT_SPP_ENABLE
	bool "Enable Xasin's BT SPP"
	depends on BTDM_CONTROLLER_MODE_BR_EDR_ONLY || BTDM_CONTROLLER_MODE_BTDM
	default false
	
endmenu
```

## ESP32/NeoController/Kconfig
```kconfig
menu "XNM Neopixel Settings"
	config XNM_NEO_IND_SPEED
		int "Time in FreeRTOS Ticks for one indicator tick"
		default 100
	config XNM_NEO_IND_IDLE_REPEAT
		int "Flash cycle ticks before repeating idle patterns"
		default 8
endmenu
```

## ESP32/NetHelper/Kconfig
```kconfig
menu "XNM NetHelpers"
    config PROJECT_NAME
        string "Logging and OTA Project name"
        default "DEV_PROJECT"
    config XNM_AUTOSTART_WIFI
        bool "Autostart WiFi"
        default 1

    menuconfig XNM_NETHELP_INCLUDE_PROPP
        bool "Include a NetHelper global property-point core?"
        default 1
    if XNM_NETHELP_INCLUDE_PROPP
        config XNM_NETHELP_PROPP_UART
            bool "Add a UART PropP instance and enable it."
            default 1
    endif

    menuconfig XNM_NETHELP_BLE_ENABLE
        bool "Activate a global BLE instance"
        default 0
    if XNM_NETHELP_BLE_ENABLE
        config XNM_NETHELP_BLE_ALWAYSON
            bool "Always activate the BLE server"
            default 0
        config XNM_NETHELP_BLE_AUTOCONF
            bool "Activate BLE when no config is present"
            default 1
        config XNM_NETHELP_BLE_CONF_GPIO
            int "Optional pin to check to force config mode (-1 to disable)"
            default -1
        config XNM_NETHELP_BLE_NONETWORK
            bool "Start BLE and go into config mode if network connection fails"
            default 1
        config XNM_NETHELP_BLE_CONFMODE_BLOCK
            bool "Block in BLE-Only config mode"
            default 0
    endif

    menu "WiFi settings"
        config XNM_WIFI_AUTOSTART
            bool "Autostart wifi connection after boot"
            default 1
        config XNM_WIFI_AUTOSTART_OTA
            bool "Autostart WiFi connection if the OTA download flag is set"
            default 1
        config XNM_WIFI_DEFAULT_SSID
            string "Default SSID to connect to"
        config XNM_WIFI_DEFAULT_PASSWORD
            string "Default password to use to connect"
        config XNM_WIFI_PSMODE
            int "Default power-save mode"
            default 0
        config XNM_WIFI_LOAD_NVS
            bool "Load WiFi setting from NVS"
            default 1
        config XNM_WIFI_FIRST_MAX_RETRIES
            int "Default retry count before stopping"
            default 3
        config XNM_WIFI_CONNECTED_MAX_RETRIES
            int "Default retry count after successful connection (0 = infinite)"
            default 0
        config XNM_WIFI_MIN_RETRY_TIME
            int "Minimum time before retry (in ms)"
            default 100
        config XNM_WIFI_MAX_RETRY_TIME
            int "Maximum time between retries (in ms)"
            default 20000
    endmenu

    config XNM_OTA_BOOTCHECK
        bool "Check the OTA version after WiFi connected and perform a OTA download"
        default 1

    menuconfig XNM_NETHELP_MQTT_ENABLE
        bool "Include a global MQTT instance"
        default 1
    if XNM_NETHELP_MQTT_ENABLE   
        config XNM_NETHELP_MQTT_CON_TIME
            int "Time (ms) to wait for MQTT connection before assuming the server is offline."
            default 20000
        config AUTOSTART_MQTT_LOG_REDIR
            bool "Start MQTT Log Relay on init"
            default 1
        config AUTOSTART_MQTT_OTA_CHECK
            bool "Use MQTT to check for updated versions and reboot"
            default 0
    endif

    config ENABLE_BLE_LOG_REDIR
        default 1
    
    config AUTOCONFIG_DEVICE_NAME
        bool "Use WiFi MAC as device ID"
        default 1
endmenu
```
